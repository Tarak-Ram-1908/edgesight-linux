## br2-external/Config.in
```kconfig
menu "EdgeSight packages"
source "$BR2_EXTERNAL_EDGESIGHT_PATH/package/onnxruntime-bin/Config.in"
source "$BR2_EXTERNAL_EDGESIGHT_PATH/package/edgesight-models/Config.in"
source "$BR2_EXTERNAL_EDGESIGHT_PATH/package/edgesightd/Config.in"
endmenu
```

## br2-external/package/edgesight-models/Config.in
```kconfig
config BR2_PACKAGE_EDGESIGHT_MODELS
	bool "edgesight-models"
	help
	  Pre-trained COCO object-detection models (hash-pinned) and a
	  small set of sample frames used for the boot-time self-test
	  and offline demo:
	   - SSD-MobileNet-v1 ONNX FP32 and INT8 (ONNX Model Zoo, Apache-2.0)
	   - SSD-MobileNet-v1 TFLite uint8 quantised (TensorFlow, Apache-2.0)
	   - COCO val2017 sample images (CC-BY 4.0)

	  Deliberately NOT YOLOv5/v8 (AGPL-3.0) to keep the image free of
	  copyleft obligations on the application.
```

## br2-external/package/edgesightd/Config.in
```kconfig
config BR2_PACKAGE_EDGESIGHTD
	bool "edgesightd"
	depends on BR2_INSTALL_LIBSTDCPP
	depends on BR2_TOOLCHAIN_HAS_THREADS
	select BR2_PACKAGE_JPEG
	select BR2_PACKAGE_MOSQUITTO
	select BR2_PACKAGE_LIBSECCOMP
	help
	  EdgeSight real-time object detection daemon: frame source
	  (JPEG folder or MJPEG-over-TCP camera stream) -> ONNX Runtime
	  or TensorFlow Lite inference -> MQTT + HTTP dashboard.
	  Self-sandboxing: privilege drop, no_new_privs, Landlock and a
	  seccomp-bpf syscall allow-list.

if BR2_PACKAGE_EDGESIGHTD

config BR2_PACKAGE_EDGESIGHTD_ORT
	bool "ONNX Runtime backend"
	default y
	depends on BR2_PACKAGE_ONNXRUNTIME_BIN

config BR2_PACKAGE_EDGESIGHTD_TFLITE
	bool "TensorFlow Lite backend"
	default y
	depends on BR2_PACKAGE_TENSORFLOW_LITE

endif
```

## br2-external/package/onnxruntime-bin/Config.in
```kconfig
config BR2_PACKAGE_ONNXRUNTIME_BIN
	bool "onnxruntime-bin"
	depends on BR2_x86_64
	depends on BR2_TOOLCHAIN_USES_GLIBC
	depends on BR2_INSTALL_LIBSTDCPP
	help
	  Microsoft ONNX Runtime (CPU execution provider), installed
	  from the official, hash-pinned x86_64 release archive.

	  The release binary uses runtime CPU dispatch (MLAS kernels
	  for SSE4.2/AVX2/AVX-512/AVX-VNNI), so a single generic build
	  is as fast as a -march specific one for the GEMM/conv hot
	  paths. Building from source is possible but pulls ~30
	  sub-projects through CMake FetchContent at build time, which
	  breaks Buildroot's offline/hash-checked download model.

	  https://onnxruntime.ai/

comment "onnxruntime-bin needs an x86_64 glibc toolchain w/ C++"
	depends on !BR2_x86_64 || !BR2_TOOLCHAIN_USES_GLIBC || !BR2_INSTALL_LIBSTDCPP
```
